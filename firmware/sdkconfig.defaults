## firmware/sdkconfig.defaults
```kconfig
# ESP32-S3 TRM Inference Configuration

# Target: ESP32-S3
CONFIG_IDF_TARGET="esp32s3"

# CPU at maximum frequency (240 MHz)
CONFIG_ESP_DEFAULT_CPU_FREQ_MHZ_240=y

# Flash: 16MB, QIO mode for maximum bandwidth
CONFIG_ESPTOOLPY_FLASHSIZE_16MB=y
CONFIG_ESPTOOLPY_FLASHMODE_QIO=y
CONFIG_ESPTOOLPY_FLASHFREQ_80M=y

# PSRAM: Enable external 8MB Octal PSRAM
CONFIG_SPIRAM=y
CONFIG_SPIRAM_MODE_OCT=y
CONFIG_SPIRAM_SPEED_80M=y

# Allow allocating from PSRAM (for model weights)
CONFIG_SPIRAM_USE_CAPS_ALLOC=y
CONFIG_SPIRAM_MALLOC_ALWAYSINTERNAL=4096

# Custom partition table
CONFIG_PARTITION_TABLE_CUSTOM=y
CONFIG_PARTITION_TABLE_CUSTOM_FILENAME="partitions.csv"

# Console UART for monitoring
CONFIG_ESP_CONSOLE_USB_SERIAL_JTAG=y

# Increase main task stack size (model inference needs more stack)
CONFIG_ESP_MAIN_TASK_STACK_SIZE=16384

# Optimize for performance
CONFIG_COMPILER_OPTIMIZATION_PERF=y

# Disable Task WDT — inference steps take ~20s (12 blocks × batched matmuls)
CONFIG_ESP_TASK_WDT_EN=n

# Enable FPU
CONFIG_ESP32S3_DEFAULT_CPU_FREQ_240=y

# Increase timer task stack
CONFIG_ESP_TIMER_TASK_STACK_SIZE=4096

# SPIFFS for model data partition
CONFIG_SPIFFS_MAX_PARTITIONS=1
```
